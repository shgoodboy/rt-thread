## bsp/imxrt/product/board/Kconfig
```kconfig
menu "Hardware Drivers Config"

config BSP_USING_QSPIFLASH
    bool
    default n

config SOC_MIMXRT1176DVMAA
    bool
    select SOC_MIMXRT1170_SERIES
    select BSP_USING_QSPIFLASH
    select RT_USING_COMPONENTS_INIT
    select RT_USING_USER_MAIN
    default y

menu "On-chip Peripheral Drivers"

    config BSP_USING_DMA
        bool "Enable DMA"
        default n

    config BSP_USING_GPIO
        bool "Enable GPIO"
        select RT_USING_PIN
        default y

    menuconfig BSP_USING_LPUART
        bool "Enable UART"
        select RT_USING_SERIAL
        default y

        if BSP_USING_LPUART
            config BSP_USING_LPUART1
                bool "Enable LPUART1"
                default y

                config BSP_LPUART1_RX_USING_DMA
                    bool "Enable LPUART1 RX DMA"
                    depends on BSP_USING_LPUART1
                    select BSP_USING_DMA
                    select RT_SERIAL_USING_DMA
                    default n

                    config BSP_LPUART1_RX_DMA_CHANNEL
                        depends on BSP_LPUART1_RX_USING_DMA
                        int "Set LPUART1 RX DMA channel (0-32)"
                        default 0

                config BSP_LPUART1_TX_USING_DMA
                    bool "Enable LPUART1 TX DMA"
                    depends on BSP_USING_LPUART1
                    select BSP_USING_DMA
                    select RT_SERIAL_USING_DMA
                    default n

                    config BSP_LPUART1_TX_DMA_CHANNEL
                        depends on BSP_LPUART1_TX_USING_DMA
                        int "Set LPUART1 TX DMA channel (0-32)"
                        default 1
						
			config BSP_USING_LPUART2
				bool "Enable LPUART2"
				default n

				config BSP_LPUART2_RX_USING_DMA
					bool "Enable LPUART2 RX DMA"
					depends on BSP_USING_LPUART2
					select BSP_USING_DMA
					select RT_SERIAL_USING_DMA
					default n

					config BSP_LPUART2_RX_DMA_CHANNEL
						depends on BSP_LPUART2_RX_USING_DMA
						int "Set LPUART2 RX DMA channel (0-32)"
						default 2

				config BSP_LPUART2_TX_USING_DMA
					bool "Enable LPUART2 TX DMA"
					depends on BSP_USING_LPUART2
					select BSP_USING_DMA
					select RT_SERIAL_USING_DMA
					default n

					config BSP_LPUART2_TX_DMA_CHANNEL
						depends on BSP_LPUART2_TX_USING_DMA
						int "Set LPUART2 TX DMA channel (0-32)"
						default 3
						
            config BSP_USING_LPUART3
                bool "Enable LPUART3"
                default n

                config BSP_LPUART3_RX_USING_DMA
                    bool "Enable LPUART3 RX DMA"
                    depends on BSP_USING_LPUART3
                    select BSP_USING_DMA
                    select RT_SERIAL_USING_DMA
                    default n

                    config BSP_LPUART3_RX_DMA_CHANNEL
                        depends on BSP_LPUART3_RX_USING_DMA
                        int "Set LPUART3 RX DMA channel (0-32)"
                        default 0

                config BSP_LPUART3_TX_USING_DMA
                    bool "Enable LPUART3 TX DMA"
                    depends on BSP_USING_LPUART3
                    select BSP_USING_DMA
                    select RT_SERIAL_USING_DMA
                    default n

                    config BSP_LPUART3_TX_DMA_CHANNEL
                        depends on BSP_LPUART3_TX_USING_DMA
                        int "Set LPUART3 TX DMA channel (0-32)"
                        default 1
			
			config BSP_USING_LPUART8
                bool "Enable LPUART8"
                default n

                config BSP_LPUART8_RX_USING_DMA
                    bool "Enable LPUART8 RX DMA"
                    depends on BSP_USING_LPUART8                   
                    select RT_SERIAL_USING_DMA
                    default n

                    config BSP_LPUART8_RX_DMA_CHANNEL
                        depends on BSP_LPUART8_RX_USING_DMA
                        int "Set LPUART8 RX DMA channel (0-32)"
                        default 6

                config BSP_LPUART8_TX_USING_DMA
                    bool "Enable LPUART8 TX DMA"
                    depends on BSP_USING_LPUART8
                    select BSP_USING_DMA
                    select RT_SERIAL_USING_DMA
                    default n

                    config BSP_LPUART8_TX_DMA_CHANNEL
                        depends on BSP_LPUART8_TX_USING_DMA
                        int "Set LPUART8 TX DMA channel (0-32)"
                        default 7
						
			config BSP_USING_LPUART10
                bool "Enable LPUART10"
                default n

                config BSP_LPUART10_RX_USING_DMA
                    bool "Enable LPUART10 RX DMA"
                    depends on BSP_USING_LPUART10                    
                    select RT_SERIAL_USING_DMA
                    default n

                    config BSP_LPUART10_RX_DMA_CHANNEL
                        depends on BSP_LPUART10_RX_USING_DMA
                        int "Set LPUART3 RX DMA channel (0-32)"
                        default 8

                config BSP_LPUART10_TX_USING_DMA
                    bool "Enable LPUART10 TX DMA"
                    depends on BSP_USING_LPUART10
                    select BSP_USING_DMA
                    select RT_SERIAL_USING_DMA
                    default n

                    config BSP_LPUART10_TX_DMA_CHANNEL
                        depends on BSP_LPUART10_TX_USING_DMA
                        int "Set LPUART10 TX DMA channel (0-32)"
                        default 9
						
			
        endif
	menuconfig BSP_USING_FLEXSPI
		bool "Enable FlexSPI"
		default y

		if BSP_USING_FLEXSPI
			config BSP_USING_FLEXSPI1
				bool "Enable FlexSPI1"
				default y
		endif
	menuconfig BSP_USING_SPI
		bool "Enable SPI"	
		default y

		if BSP_USING_SPI
			config BSP_USING_SPI1
				bool "Enable SPI1"
				default y

			config BSP_USING_SPI4
				bool "Enable SPI4"
				default n
			
			config BSP_USING_BLOCKING_SPI
				bool "Enable BLOCKING SPI"
				default y
		endif
	menuconfig BSP_USING_SDIO
		bool "Enable SDIO"	
		default n
		
		if BSP_USING_SDIO
			config BSP_USING_SDIO1
				bool "Enable SDIO1"
				default n
			config BSP_SDIO_EN_PORT
				int "Set SDIO EN PORT"
				default 3
			config BSP_SDIO_EN_PIN
				int "Set SDIO EN PIN"
				default 5
			config BSP_SDIO_EN_ACTIVE_LEVEL
				int "Set SDIO EN ACTIVE LEVEL"
				default 1
			config BSP_SDIO_WAIT_AFTER_EN
				int "Set SDIO WAIT AFTER EN"
				default 5000
		endif
	menuconfig BSP_USING_ESP32
		bool "Enable ESP32"
		default n

		if BSP_USING_ESP32
			menuconfig BSP_USING_ESP32_EN
				bool "Enable ESP32 EN"
				default n

				if BSP_USING_ESP32_EN
					config BSP_USING_ESP32_EN_PORT
						int "Set ESP32 EN PORT"
						default 3
					config BSP_USING_ESP32_EN_PIN
						int "Set ESP32 EN PIN"
						default 5
				endif
		endif
	menuconfig BSP_USING_EFR32
		bool "Enable EFR32"
		default n

		if BSP_USING_EFR32
			menuconfig BSP_USING_EFR32_RST
				bool "Enable EFR32 RST"
				default n

				if BSP_USING_EFR32_RST
					config BSP_USING_EFR32_RST_PORT
						int "Set EFR32 RST PORT"
						default 3
					config BSP_USING_EFR32_RST_PIN
						int "Set EFR32 RST PIN"
						default 10
				endif
		endif
		
	menuconfig BSP_USING_ANTENNA_RF_SWITCH
		bool "Enable Antenna RF Switch"
		default n

		if BSP_USING_ANTENNA_RF_SWITCH
			menuconfig BSP_USING_ANTENNA_RF_SWITCH_ESP32
				bool "Enable Antenna RF Switch ESP32"
				default n

				if BSP_USING_ANTENNA_RF_SWITCH_ESP32
					config BSP_USING_ANTENNA_RF_SWITCH_ESP32_PORT
						int "Set Antenna RF Switch ESP32 PORT"
						default 3
					config BSP_USING_ANTENNA_RF_SWITCH_ESP32_PIN
						int "Set Antenna RF Switch ESP32 PIN"
						default 9
				endif

			menuconfig BSP_USING_ANTENNA_RF_SWITCH_EFR32
				bool "Enable Antenna RF Switch EFR32"
				default n

				if BSP_USING_ANTENNA_RF_SWITCH_EFR32
					config BSP_USING_ANTENNA_RF_SWITCH_EFR32_PORT
						int "Set Antenna RF Switch EFR32 PORT"
						default 3
					config BSP_USING_ANTENNA_RF_SWITCH_EFR32_PIN
						int "Set Antenna RF Switch EFR32 PIN"
						default 10
				endif
		endif
	
endmenu

menu "Onboard Peripheral Drivers"

    config BSP_USING_SDRAM
        bool "Enable SDRAM"
        default n

    menuconfig BSP_USING_ETH
    bool "Enable Ethernet"
    select RT_USING_NETDEV
    select RT_USING_LWIP
    default n


    if BSP_USING_ETH
        config BSP_USING_PHY
            select RT_USING_PHY
            bool "Enable ethernet phy"
            default y

        if BSP_USING_PHY
			choice BSP_USING_PHY_TYPE
				prompt "Select PHY type"
				default PHY_USING_RTL8201F
				help
					Select the PHY type.
				config PHY_USING_RTL8201F
					bool "RTL8201F"
					help
						Select RTL8201F PHY.
				config PHY_USING_RTL8304
					bool "RTL8304"
					help
						Select RTL8304 PHY.
		    endchoice
			
			if PHY_USING_RTL8304
				config RTL8304_MDCS_PORT
					int "Set RTL8304 MDCS PORT"
					default 3
				config RTL8304_MDCS_PIN
					int "Set RTL8304 MDC PIN"
					default 31
				config RTL8304_MDIO_PORT
					int "Set RTL8304 MDIO PORT"
					default 4
				config RTL8304_MDIO_PIN
					int "Set RTL8304 MDIO PIN"
					default 0
					
				config PHY_ADDRESS
					int "Set PHY address"
					default 1

				config PHY_NAME
					string "Set PHY name"
					default "realtek"
					
				menuconfig BSP_USING_PHY_LED
					bool "Enable PHY LED"
					default n

					if BSP_USING_PHY_LED
						menuconfig BSP_USING_PHY_LED_PORT1
							bool "Enable PHY LED PORT1"
							default n

							if BSP_USING_PHY_LED_PORT1
								config BSP_USING_PHY_LED_PORT1_PORT
									int "Set PHY LED PORT1 PORT"
									default 6
								config BSP_USING_PHY_LED_PORT1_PIN
									int "Set PHY LED PORT1 PIN"
									default 8
							endif

						menuconfig BSP_USING_PHY_LED_PORT2
							bool "Enable PHY LED PORT2"
							default n

							if BSP_USING_PHY_LED_PORT2
								config BSP_USING_PHY_LED_PORT2_PORT
									int "Set PHY LED PORT2 PORT"
									default 6
								config BSP_USING_PHY_LED_PORT2_PIN
									int "Set PHY LED PORT2 PIN"
									default 9
							endif
					endif
						
				menuconfig BSP_USING_PHY_RST
					bool "Enable PHY RST"
					default n

					if BSP_USING_PHY_RST
						config BSP_USING_PHY_RST_PORT
							int "Set PHY RST PORT"
							default 3
						config BSP_USING_PHY_RST_PIN
							int "Set PHY RST PIN"
							default 12
					endif
			endif	
			
			menuconfig BSP_USING_ETH_INT
				bool "Enable ETH INT"
				default n

				if BSP_USING_ETH_INT
					config BSP_USING_ETH_INT_PORT
						int "Set ETH INT PORT"
						default 3
					config BSP_USING_ETH_INT_PIN
						int "Set ETH INT PIN"
						default 11
				endif

			config BSP_USING_ENET
				bool "Enable ENET"
				default n
            
        endif

        
    endif
	
	menuconfig BSP_USING_SPI_FLASH
        bool "Enable SPI FLASH Support"
        default y        
        if BSP_USING_SPI_FLASH
            config BSP_SPI_FLASH_SPI_BUS
                string "SPI Bus Used By SPI FLASH"
                default "spi1"
            config BSP_SPI_FLASH_BUS_NAME
                string "Set FLASH SPI Bus Name"
                default "spiflash"
            config BSP_SPI_FLASH_DEV_NAME
                string "Set SPI Flash Device Name"
                default "w25q16"            
        endif
	config BSP_USING_ESP32
        bool "Enable ESP32"
		default y
        select RT_USING_AT
        select AT_USING_CLIENT
        select AT_USING_SOCKET
        select PKG_USING_AT_DEVICE
        select AT_DEVICE_USING_ESP32
		select AT_DEVICE_ESP32_INIT_ASYN
       
endmenu

menu "Board extended module Drivers"

endmenu

endmenu
```

## components/drivers/sdio/Kconfig
```kconfig
config RT_USING_SDIO
    bool "Using SD/MMC device drivers"
    default n
    help
        This option enables the SD/MMC device drivers.

if RT_USING_SDIO

    config RT_SDIO_STACK_SIZE
        int "The stack size for sdio irq thread"
        default 512

    config RT_SDIO_THREAD_PRIORITY
        int "The priority level value of sdio irq thread"
        default 15

    config RT_MMCSD_STACK_SIZE
        int "The stack size for mmcsd thread"
        default 1024

    config RT_MMCSD_THREAD_PREORITY
        int "The priority level value of mmcsd thread"
        default 22

    config RT_MMCSD_MAX_PARTITION
        int "mmcsd max partition"
        default 16

    config RT_SDIO_DEBUG
        bool "Enable SDIO debug log output"
        default n

    config RT_USING_ESP32_SDIO_AT
        bool "Using ESP32 SDIO AT Command Driver"
        depends on RT_USING_SDIO
        default n
        help
            Enable ESP32 SDIO AT command driver for WiFi communication.

    if RT_USING_ESP32_SDIO_AT

        config ESP32_SDIO_AT_BLOCK_SIZE
            int "ESP32 SDIO block size"
            default 512
            help
                SDIO block size for ESP32 communication.

        config ESP32_SDIO_AT_MAX_RESPONSE
            int "ESP32 SDIO maximum response size"
            default 2048
            help
                Maximum response buffer size for ESP32 AT commands.

        config ESP32_SDIO_AT_CMD_TIMEOUT
            int "ESP32 SDIO command timeout (ms)"
            default 5000
            help
                Timeout for ESP32 AT command execution in milliseconds.

        config ESP32_SDIO_AT_THREAD_STACK
            int "ESP32 SDIO AT thread stack size"
            default 2048
            help
                Stack size for ESP32 SDIO AT response handling thread.

        config ESP32_SDIO_AT_THREAD_PRIORITY
            int "ESP32 SDIO AT thread priority"
            default 20
            help
                Priority for ESP32 SDIO AT response handling thread.

        config ESP32_SDIO_AT_DEBUG
            bool "Enable ESP32 SDIO AT debug output"
            default n
            help
                Enable debug output for ESP32 SDIO AT driver.

        config ESP32_SDIO_AT_EXAMPLE
            bool "Enable ESP32 SDIO AT example application"
            default y
            help
                Enable ESP32 SDIO AT example application with MSH commands.

    endif

endif
```
